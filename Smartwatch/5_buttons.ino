/*
  Commands related to onboard buttons connected as interrupts
*/

long unsigned timer1 = 0, timer2 = 0;         //timers to debounce onboard buttons
int debounceTime = 300;                       //millis

//////////////////////////////////////////////////////////////////////////////////////////////////////////////////////////////////////
//////////////////////////////////////////////////////////////////////////////////////////////////////////////////////////////////////

void buttonssetup() {
  pinMode(BUTTON1PIN, INPUT);
  pinMode(BUTTON2PIN, INPUT);
  attachInterrupt(BUTTON1PIN, toggleButton1, FALLING);
  //  attachInterrupt(BUTTON2PIN, toggleButton2_t, FALLING);    //interrupt doesnt work well with deepsleep
}

//////////////////////////////////////////////////////////////////////////////////////////////////////////////////////////////////////
//////////////////////////////////////////////////////////////////////////////////////////////////////////////////////////////////////

void toggleButton1() {
  if (millis() - timer1 > debounceTime)
  {
    timer1 = millis();
    delay(5);
    screen++;
    if (screen <= 0)
      screen = lastscreen;
    else if (screen > no_screens)
      screen = 1;
    Serial.print("Screen ");
    Serial.println(screen);
    tft.fillScreen(backgroundColor);
    active = 1;
    tftupdate = 1;
    tftfullupdate = 1;
  }
}

//////////////////////////////////////////////////////////////////////////////////////////////////////////////////////////////////////
//////////////////////////////////////////////////////////////////////////////////////////////////////////////////////////////////////

void toggleButton2() {
  if (digitalRead(BUTTON2PIN) == LOW) {
    timer2 = millis();
    Serial.println("button2");
    while (digitalRead(BUTTON2PIN) == LOW) {
      if (millis() - timer2 > 1000) {
        gotosleep(2);
      }
      delay(100);
    }
  }
}
